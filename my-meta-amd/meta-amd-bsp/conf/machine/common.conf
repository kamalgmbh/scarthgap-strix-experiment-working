## my-meta-amd/meta-amd-bsp/conf/machine/common.conf
```bitbake
IMAGE_TYPEDEP_wic = "ext4"
LABELS_LIVE = "boot install"
EFI_PROVIDER = "grub-efi"
do_image_wic[depends] += "${INITRD_IMAGE_LIVE}:do_image_complete"
do_rootfs[depends] += "virtual/kernel:do_deploy"
VIRTUAL-RUNTIME_init_manager = "systemd"
DISTRO_FEATURES_BACKFILL_CONSIDERED = "sysvinit"
MACHINE_FEATURES_NATIVE:append = " efi"
MACHINE_FEATURES:append = " efi"
MACHINE_FEATURES:append = " pcbios util-linux-blkid"
IMAGE_INSTALL:append = " grub grub-efi grub-bootconf"
CORE_IMAGE_EXTRA_INSTALL:append = " kernel-modules"
```

## my-meta-amd/meta-amd-bsp/conf/machine/kernel.conf
```bitbake
PREFERRED_VERSION_linux-yocto = "6.6.26"

#Exclude 24.0.2 mesa for siena,v1000 and v2000
BBMASK = "\
  meta-amd/meta-amd-bsp/recipes-graphics/mesa\
  recipes-extended/xen\
  "
BBMASK += "recipes-core/initrdscripts/initramfs-module-install-efi_1.0.bbappend"
```

## my-meta-amd/meta-amd-bsp/conf/machine/stx.conf
```bitbake
#@TYPE: Machine
#@NAME: v2000a

#@DESCRIPTION: Machine configuration for Siena systems

require conf/machine/include/tune-zen2.inc
require conf/machine/include/uart.inc
PREFERRED_VERSION_linux-yocto = "6.8"

LICENSE_FLAGS_ACCEPTED = " commercial_ffmpeg commercial_x264 commercial_x265 commercial_mpeg2dec commercial_faad2"

MACHINE_EXTRA_RRECOMMENDS += "git gdb make cmake gcc g++ vim libkcapi libtool util-linux glmark2 vulkan-tools mesa-demos ffmpeg mpv libva-utils vkcube libgpiod libgpiod-tools libgpiod-dev i2c-tools ethtool ldd netplan tar vulkan-cts opengl-es-cts f2fs-tools p7zip gptfdisk dosfstools"

#For installing mesa
MACHINE_EXTRA_RRECOMMENDS += "mesa libegl-mesa libegl-mesa-dev  libosmesa libosmesa-dev  libgl-mesa libgl-mesa-dev  libglx-mesa libglx-mesa-dev libglapi libglapi-dev  libgbm libgbm-dev  libgles1-mesa libgles1-mesa-dev  libgles2-mesa libgles2-mesa-dev libgles3-mesa libgles3-mesa-dev libxatracker libxatracker-dev  mesa-megadriver mesa-vulkan-drivers mesa-vdpau-drivers mesa-tools"

XSERVER ?= "xserver-xorg \
        xf86-video-amdgpu \
        xf86-video-modesetting \
        xf86-video-fbdev \
        xf86-video-vesa \
        xf86-video-ati \
        xf86-video-intel \
        xf86-video-nouveau \
        xf86-video-vmware \
        "
LLVMVERSION = "18.1.2"
PREFERRED_VERSION_libsdl2 = "2.30.1"

IMAGE_INSTALL:append = " kernel-modules nvme-cli spitools linux-firmware spidev-test rpm opkg lshw  autoconf stress-ng hwloc numactl packagegroup-core-buildessential alsa-utils libsdl2 virglrenderer seabios ovmf-edk2 qemu-xen iperf3 packagegroup-xfce-base amdgpu-firmware"

include conf/machine/common.conf
DISTRO_FEATURES:append = " virtualization xen systemd"
PREFERRED_VERSION_xen ?= "4.18+stable%"
PREFERRED_VERSION_xen-tools?= "4.18+stable%"
GRUB_BUILDIN ?= "boot linux ext2 fat serial part_msdos part_gpt normal \
                efi_gop iso9660 configfile search loadenv test multiboot multiboot2 syslinuxcfg"
```
